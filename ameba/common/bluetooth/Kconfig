## ameba/common/bluetooth/Kconfig
```kconfig
# Copyright (c) 2024 Realtek Semiconductor Corp.
# SPDX-License-Identifier: Apache-2.0

config REALTEK_AMEBA_ZEPHYR_BT
	bool "RealTek Ameba Zephyr BT"
	default n
	select ZEPHYR_MBEDTLS_MODULE
	select SHARED_INTERRUPTS
	help
	  This option enables the Realtek Ameba BT.

if REALTEK_AMEBA_ZEPHYR_BT

config BT
	bool "Enable BT"
	default y

config BT_SMP
	bool
	default y

config BT_SHELL
	bool
	default y

config BT_PERIPHERAL
	bool "Enable BT Peripheral"
	default n

config BT_CENTRAL
	bool "Enable BT Central"
	default n

if BT_CENTRAL
	config BT_GATT_CLIENT
		bool
		default y
endif

config BT_PRIVACY
	bool "Enable BT Privacy"
	default n

config BT_EXT_ADV
	bool "Enable BT Extended Advertising"
	default n

if BT_EXT_ADV
	config BT_EXT_ADV_MAX_ADV_SET
		int "Max Advertising Sets"
		default 2
endif

config COMMON_LIBC_MALLOC_ARENA_SIZE
	default 8192

config BT_BUF_ACL_TX_COUNT
	default 8

config BT_CLASSIC
	bool "Enable BT Classic"
	depends on SOC_SERIES_AMEBASMART
	default n

config BT_A2DP
	bool "Enable BT A2DP"
	depends on BT_CLASSIC
	select LIBSBC
	default n

if BT_A2DP

	config BT_PERIPHERAL
		bool
		default y

	config BT_CENTRAL
		bool
		default y

	config BT_A2DP_SINK
		bool
		default y

	config BT_AVDTP
		bool
		default y

	config BT_A2DP_SOURCE
		bool
		default y

	config USE_CODEC_CLOCK
		bool "I2S BCK is generated by a selected codec device"
		help
		If selected, the I2S selected peripheral will be configured to consume
		(receive) the I2S BCK and WS signals and the codec will be configured
		to generate those. If not selected, the I2S peripheral will generate
		them and the codec will be expected to consume them.

	config A2DP_SBC_PCM_BUFFER_PLAY_COUNT
		int
		default 50

	config A2DP_BOARD_CODEC_PLAY_COUNT
		int
		default 4

	config A2DP_BOARD_CODEC_PLAY_THRESHOLD
		int
		default 20

	config BT_A2DP_SOURCE_DISCOVER_RESULT_COUNT
		int
		default 10

	config BT_A2DP_SOURCE_EPS_DISCOVER_COUNT
		int
		default 5

	config BT_A2DP_SOURCE_SBC_BIT_RATE_DEFAULT
		int
		default 229

	config BT_A2DP_SOURCE_DATA_SEND_INTERVAL
		int
		default 10

	config BT_A2DP_SOURCE_DATA_BUF_SIZE
		int
		default 1000

	config BT_A2DP_SOURCE_DATA_BUF_COUNT
		int
		default 5

	config BT_A2DP_SOURCE_DATA_SEND_WORKQ_STACK_SIZE
		int
		default 1024

	config BT_A2DP_SOURCE_DATA_SEND_WORKQ_PRIORITY
		int
		default SYSTEM_WORKQUEUE_PRIORITY

	config BT_COD
		hex
		default 0x200404

	config BT_BUF_ACL_RX_SIZE
		int
		default 1300
endif


if SETTINGS
	config BT_SETTINGS
		bool
		default y
endif

endif # REALTEK_AMEBA_ZEPHYR_BT
```

## ameba/common/rtk_coex/Kconfig
```kconfig
# Copyright (c) 2024 Realtek Semiconductor Corp.
# SPDX-License-Identifier: Apache-2.0

if REALTEK_AMEBA_ZEPHYR_WIFI

config BT_COEXIST
	bool "Enable CoExist"
	default y if !SOC_SERIES_AMEBAD && !SOC_SERIES_AMEBASMART
	select COEXIST_HOST if !SINGLE_CORE_WIFI
	select PLATFORM_ZEPHYR

config COEXIST_HOST
	bool
config COEXIST_DEV
	bool
config PLATFORM_ZEPHYR
	bool

config COEXIST_EXT
	bool "Enable Ext Coex Support"
	depends on BT_COEXIST && !SOC_SERIES_AMEBAD
	default n
	select COEX_EXT_CHIP_SUPPORT

# PTA Mode
config EXT_PTA_MODE_SIMPLE
	bool "PTA Mode Simple"
	depends on COEXIST_EXT

config EXT_PTA_MODE_MULTIPLE
	bool "PTA Mode Multiple"
	depends on COEXIST_EXT

# Ext Protocol
config EXT_PROTOCOL_WPAN
	bool "Ext WPAN"
	depends on COEXIST_EXT
	default y if COEXIST_EXT

config EXT_PROTOCOL_BT
	bool "Ext BT"
	depends on COEXIST_EXT

config EXT_PROTOCOL_BT_WPAN
	bool "Ext BT&WPAN"
	depends on COEXIST_EXT

# Priority Mode
config EXT_PRIORITY_DIRECTIONAL
	bool "Priority Directional"
	depends on COEXIST_EXT
	default y if COEXIST_EXT

config EXT_PRIORITY_STATIC
	bool "Priority Static"
	depends on COEXIST_EXT && EXT_PTA_MODE_SIMPLE

# Request Polar
config EXT_REQUEST_POLAR_HIGH
	bool "Request Active High"
	depends on COEXIST_EXT
	default y if COEXIST_EXT

config EXT_REQUEST_POLAR_LOW
	bool "Request Active Low"
	depends on COEXIST_EXT && EXT_PTA_MODE_SIMPLE

# Gnt Polar
config EXT_GNT_POLAR_LOW
	bool "Gnt Active Low"
	depends on COEXIST_EXT
	default y if COEXIST_EXT

config EXT_GNT_POLAR_HIGH
	bool "Gnt Active High"
	depends on COEXIST_EXT && EXT_PTA_MODE_SIMPLE

config EXT_PRI_DET_TIME
	int "Priority Det Time"
	depends on COEXIST_EXT
	range 0 254
	# 2 for RTL8771H; 0 for Silicon Thread RCP
	default 2

config EXT_TRX_DET_TIME
	int "TRX Det Time"
	depends on COEXIST_EXT
	range 0 254
	# 8 for RTL8771H; 20 for Silicon Thread RCP
	default 8

# PTA PINMUX PIN set
config EXT_PTA_PIN_REQ
	string "Pin PTA Request"
	depends on COEXIST_EXT
	default "PB_0" if SOC_SERIES_AMEBADPLUS
	default "PA_21" if SOC_SERIES_AMEBAG2
	default "PA_26" if SOC_SERIES_AMEBAD
	default "PA_10" if SOC_SERIES_AMEBASMART

config EXT_PTA_PIN_PRI
	string "Pin PTA Priority"
	depends on COEXIST_EXT
	default "PB_2" if SOC_SERIES_AMEBADPLUS
	default "PA_18" if SOC_SERIES_AMEBAG2
	default "PB_1" if SOC_SERIES_AMEBAD
	default "PA_6" if SOC_SERIES_AMEBASMART

config EXT_PTA_PIN_GNT
	string "Pin PTA Gnt"
	depends on COEXIST_EXT
	default "PB_1" if SOC_SERIES_AMEBADPLUS
	default "PA_19" if SOC_SERIES_AMEBAG2
	default "PA_27" if SOC_SERIES_AMEBAD
	default "PA_9" if SOC_SERIES_AMEBASMART

config COEX_EXT_CHIP_SUPPORT
	bool

endif # REALTEK_AMEBA_ZEPHYR_WIFI
```

## ameba/common/usb/Kconfig
```kconfig
# Copyright (c) 2024 Realtek Semiconductor Corp.
# SPDX-License-Identifier: Apache-2.0

config REALTEK_AMEBA_ZEPHYR_USB
	bool "RealTek Ameba Zephyr USB stack"
	default n
	depends on DT_HAS_REALTEK_AMEBA_USB_ENABLED
	help
	  This option enables the Realtek Ameba Zephyr USB stack.

if REALTEK_AMEBA_ZEPHYR_USB

# USB Mode selection
config USB_DEVICE_AMEBA
	bool "USB Device Mode"

config USB_HOST_AMEBA
	bool "USB Host Mode"

# Device Class selection
config USBD_CDC_ACM
	bool "CDC ACM device"
	depends on USB_DEVICE_AMEBA
	help
	  This option enables the Realtek Ameba Zephyr USB CDC ACM device.

config USBD_HID
	bool "HID device"
	depends on USB_DEVICE_AMEBA
	help
	  This option enables the Realtek Ameba Zephyr USB HID device.

config USBD_MSC
	bool "MSC device"
	depends on USB_DEVICE_AMEBA
	help
	  This option enables the Realtek Ameba Zephyr USB MSC device.

config USBD_MSC_RAM_DISK
	bool "MSC RAM disk"
	depends on USBD_MSC
	help
	  This option to use RAM as storage media.

config USBD_MSC_RAM_DISK_ZEPHYR_FATFS
	bool "Use RAM with fatfs"
	depends on USBD_MSC_RAM_DISK

config USBD_COMPOSITE
	bool "Composite device"
	depends on USB_DEVICE_AMEBA

config USBD_VENDOR
	bool "VENDOR device"
	depends on USB_DEVICE_AMEBA
	help
	  This option enables the Realtek Ameba Zephyr USB VENDOR device.

config USBD_DFU
	bool "DFU device"
	depends on USB_DEVICE_AMEBA
	help
	  This option enables the Realtek Ameba Zephyr USB DFU (Device Firmware Update) device.

# Composite Class selection
config USBD_COMPOSITE_CDC_ACM_HID
	bool "Composite CDC ACM + HID"
	depends on USBD_COMPOSITE

config USBD_COMPOSITE_CDC_ACM_MSC
	bool "Composite CDC ACM + MSC"
	depends on USBD_COMPOSITE

config COMP_MSC_RAM_DISK
	bool "Composite MSC RAM disk"
	depends on USBD_COMPOSITE_CDC_ACM_MSC
	help
	  This option to use RAM as storage media.

config COMP_MSC_RAM_DISK_ZEPHYR_FATFS
	bool "Use RAM with fatfs"
	depends on COMP_MSC_RAM_DISK

# Host Class selection
config USBH_CDC_ACM
	bool "CDC ACM host"
	depends on USB_HOST_AMEBA
	help
	  This option enables the Realtek Ameba Zephyr USB CDC ACM host.

config USBH_VENDOR
	bool "VENDOR host"
	depends on USB_HOST_AMEBA
	help
	  This option enables the Realtek Ameba Zephyr USB VENDOR host.

config USBH_UAC
	bool "UAC host"
	depends on USB_HOST_AMEBA
	help
	  This option enables the Realtek Ameba Zephyr USB UAC host.

config USBH_DFU
	bool "DFU host"
	depends on USB_HOST_AMEBA
	help
	  This option enables the Realtek Ameba Zephyr USB DFU (Device Firmware Update) host.

config USBH_COMPOSITE
	bool "Composite host"
	depends on USB_HOST_AMEBA

config USBH_COMPOSITE_HID_UAC
	bool "Composite HID + UAC"
	depends on USBH_COMPOSITE

config USBH_COMPOSITE_HID_UAC1
	bool "UAC 1.0"
	depends on USBH_COMPOSITE_HID_UAC

config USBH_UVC
	bool "UVC host"
	depends on USB_HOST_AMEBA
	help
	  This option enables the Realtek Ameba Zephyr USB UVC (USB Video Class) host.

config USBH_UVC_FRAME_BUF_SIZE
	int "UVC frame buffer size (bytes)"
	depends on USBH_UVC
	default 174080
	help
	  Size of each UVC video frame buffer in bytes (3 buffers are allocated).
	  For MJPEG 720p 30fps: avg ~41KB, recommend 125-170KB (default 174080).
	  Boards with limited SRAM (e.g. rtl8721f_evb 296KB) should reduce this;
	  40960 (40KB) works for VGA/QVGA capture with hardware decode.
	  For 720p on rtl8721f_evb with hardware decode, enable PSRAM and use 174080.

endif # REALTEK_AMEBA_ZEPHYR_USB
```
