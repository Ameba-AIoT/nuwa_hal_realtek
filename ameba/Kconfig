## ameba/Kconfig
```kconfig
# Copyright (c) 2024 Realtek Semiconductor Corp.
# SPDX-License-Identifier: Apache-2.0

if SOC_FAMILY_REALTEK_AMEBA

config REALTEK_AMEBA_HAL_LIB
	bool "RealTek Ameba HAL library"
	default y
	help
	  This option enables the Realtek Ameba HAL library.

config ARM_CORE_CM4
	bool
	default y if SOC_SERIES_AMEBAD || SOC_SERIES_AMEBADPLUS

config SOC_SERIES_AMEBADPLUS
	bool

config SOC_SERIES_AMEBAD
	bool

endif # SOC_FAMILY_REALTEK_AMEBA
```

## ameba/amebaG2/Kconfig
```kconfig
# Copyright (c) 2024 Realtek Semiconductor Corp.
# SPDX-License-Identifier: Apache-2.0

config ARM_CORE_CM4
	bool
	default y if SOC_SERIES_AMEBAG2

config ARM_CORE_CM4_KM4TZ
	bool
	default y if SOC_SERIES_AMEBAG2

# comment "--------Build Config---------"
menu "Build Option"

choice
    prompt "Chip Version"
    default AMEBAGREEN2_A_CUT
    config AMEBAGREEN2_A_CUT
        bool "AMEBAGREEN2_A_Cut"

    config AMEBAGREEN2_B_CUT
        bool "AMEBAGREEN2_B_Cut"
endchoice

endmenu
```

## ameba/common/wifi/Kconfig
```kconfig
# Copyright (c) 2024 Realtek Semiconductor Corp.
# SPDX-License-Identifier: Apache-2.0

config REALTEK_AMEBA_ZEPHYR_WIFI
	bool "RealTek Ameba Zephyr WIFI"
	default n
	help
	  This option enables the Realtek Ameba WIFI.

if REALTEK_AMEBA_ZEPHYR_WIFI
config WLAN
	bool "enable wifi"
	default y

config AS_INIC_AP
	bool

config SINGLE_CORE_WIFI
	bool

config REALTEK_AMEBA_WIFI_TEST
	bool "RealTek Ameba Zephyr WIFI TEST"
	help
	  This option enables the Realtek Ameba Zephyr WIFI TEST.

config REALTEK_AMEBA_WIFI_INIC
	bool "RealTek Ameba Zephyr WIFI INIC"
	default y
	help
	  This option use inic ipc or not

config RTK_WIFI_EVENT_TASK_PRIO
	int "Event Task Priority"
	default 4

config REALTEK_AMEBA_WIFI_FASTCONN
	bool "RealTek Ameba Zephyr WIFI Fast Connect"
	default n
	help
	  This option enable Fast connect or not

config HEAP_MEM_POOL_SIZE
	default 65536

# amebad need this
config SYSTEM_WORKQUEUE_STACK_SIZE
	default 2048

endif # REALTEK_AMEBA_ZEPHYR_WIFI
```
